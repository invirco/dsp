# ADSP-SC83xW_HPC register map
Vendor: Analog Devices; Series: ADSP-SC83xW_HPC; File version: 3.0.3.517
CPU: 
Registers are 32-bit, read-write, reset 0x0 unless marked. A register's access mark holds for its fields unless they carry their own. Offsets are from the block's base; [hi:lo] are bit positions; {n}, {i} and the like mark numbered series.

## SCB0 — System Interconnect Fabric
Base 0x00000000
0xA020 M_AXI_IB_SYNC_MODE reset 0x4 — Synchronization Mode Register
  [2:0] sync_mode range 0x00000000..0x00000007 — Synchronization Mode
{0x42100+0x2000*i} SP{i}A_READ_QOS reset 0xC (i=0..2) — SP{i}A Read Quality of Service Register
  [3:0] AR_QOS range 0x00000000..0x0000000F — Read QOS
{0x42104+0x2000*i} SP{i}A_WRITE_QOS reset 0xC (i=0..3) — SP{i}A Write Quality of Service Register
  [3:0] AW_QOS range 0x00000000..0x0000000F — Write QOS
{0x43100+0x2000*i} SP{i}B_READ_QOS reset 0xC (i=0..3) — SP{i}B Read Quality of Service Register
  [3:0] AR_QOS range 0x00000000..0x0000000F — Read QOS
{0x43104+0x2000*i} SP{i}B_WRITE_QOS reset 0xC (i=0..3) — SP{i}B Write Quality of Service Register
  [3:0] AW_QOS range 0x00000000..0x0000000F — Write QOS
0x48100 SP3A_READ_QOS reset 0xC — SP3B Read Quality of Service Register
  [3:0] AR_QOS range 0x00000000..0x0000000F — Read QOS
0x4A100 CRC0_CH0_IB_READ_QOS reset 0x1 — CRC0 Channel 0 Read Quality of Service Register
  [3:0] AR_QOS range 0x00000000..0x0000000F — Read QOS
0x4A104 CRC0_CH0_IB_WRITE_QOS reset 0x1 — CRC0 Channel 0 Write Quality of Service Register
  [3:0] AW_QOS range 0x00000000..0x0000000F — Write QOS
0x4B100 CRC0_CH1_IB_READ_QOS reset 0x1 — CRC0 Channel 1 Read Quality of Service Register
  [3:0] AR_QOS range 0x00000000..0x0000000F — Read QOS
0x4B104 CRC0_CH1_IB_WRITE_QOS reset 0x1 — CRC0 Channel 1 Write Quality of Service Register
  [3:0] AW_QOS range 0x00000000..0x0000000F — Write QOS
0x4C100 CRC1_CH0_IB_READ_QOS reset 0x1 — CRC1 Channel 0 Read Quality of Service Register
  [3:0] AR_QOS range 0x00000000..0x0000000F — Read QOS
0x4C104 CRC1_CH0_IB_WRITE_QOS reset 0x1 — CRC1 Channel 0 Write Quality of Service Register
  [3:0] AW_QOS range 0x00000000..0x0000000F — Write QOS
0x4D100 CRC1_CH1_IB_READ_QOS reset 0x1 — CRC1 Channel 1 Read Quality of Service Register
  [3:0] AR_QOS range 0x00000000..0x0000000F — Read QOS
0x4D104 CRC1_CH1_IB_WRITE_QOS reset 0x1 — CRC1 Channel 1 Write Quality of Service Register
  [3:0] AW_QOS range 0x00000000..0x0000000F — Write QOS
0x4E100 UART2_RX_READ_QOS reset 0xC — UART RX Read Quality of Service Register
  [3:0] AR_QOS range 0x00000000..0x0000000F — Read QOS
0x4E104 UART2_RX_WRITE_QOS reset 0xC — UART2 RX SH0 Write Quality of Service Register
  [3:0] AW_QOS range 0x00000000..0x0000000F — Write QOS
0x4F100 SH0_DPORT_READ_QOS reset 0x7 — SH0 DPORT Read Quality of Service Register
  [3:0] AR_QOS range 0x00000000..0x0000000F — Read QOS
0x4F104 SH0_DPORT_WRITE_QOS reset 0x7 — SH0 DPORT Write Quality of Service Register
  [3:0] AW_QOS range 0x00000000..0x0000000F — Write QOS
0x50100 SH0_IPORT_READ_QOS reset 0x7 — SH0 IPORT Read Quality of Service Register
  [3:0] AR_QOS range 0x00000000..0x0000000F — Read QOS
0x50104 SH0_IPORT_WRITE_QOS reset 0x7 — SH0 IPORT Write Quality of Service Register
  [3:0] AW_QOS range 0x00000000..0x0000000F — Write QOS
0x51100 SP4A_READ_QOS reset 0xC — SP4A Read Quality of Service Register
  [3:0] AR_QOS range 0x00000000..0x0000000F — Read QOS
0x51104 SP4A_WRITE_QOS reset 0xC — SP4A Write Quality of Service Register
  [3:0] AW_QOS range 0x00000000..0x0000000F — Write QOS
0x52100 SP4B_READ_QOS reset 0xC — SP4B Read Quality of Service Register
  [3:0] AR_QOS range 0x00000000..0x0000000F — Read QOS
0x52104 SP4B_WRITE_QOS reset 0xC — SP4B Write Quality of Service Register
  [3:0] AW_QOS range 0x00000000..0x0000000F — Write QOS
0x53100 XSPI_M_IB_READ_QOS reset 0xC — XSPI Read Quality of Service Register
  [3:0] AR_QOS range 0x00000000..0x0000000F — Read QOS
0x53104 XSPI_M_IB_WRITE_QOS reset 0xC — XSPI Write Quality of Service Register
  [3:0] AW_QOS range 0x00000000..0x0000000F — Write QOS
0x54100 GIGE_IB_READ_QOS reset 0x7 — GIGE Read Quality of Service Register
  [3:0] AR_QOS range 0x00000000..0x0000000F — Read QOS
0x54104 GIGE_IB_WRITE_QOS reset 0x7 — GIGE Write Quality of Service Register
  [3:0] AW_QOS range 0x00000000..0x0000000F — Write QOS
0x55100 HSMDMA_CH0_IB_READ_QOS reset 0x1 — HSMDMA Channel 0 Read Quality of Service Register
  [3:0] AR_QOS range 0x00000000..0x0000000F — Read QOS
0x55104 HSMDMA_CH0_IB_WRITE_QOS reset 0x1 — HSMDMA Channel 0 Write Quality of Service Register
  [3:0] AW_QOS range 0x00000000..0x0000000F — Write QOS
0x56100 SP5A_READ_QOS reset 0xC — SP5A Read Quality of Service Register
  [3:0] AR_QOS range 0x00000000..0x0000000F — Read QOS
0x56104 SP5A_WRITE_QOS reset 0xC — SP5A Write Quality of Service Register
  [3:0] AW_QOS range 0x00000000..0x0000000F — Write QOS
0x57100 MLB_READ_QOS reset 0xC — MLB Read Quality of Service Register
  [3:0] AR_QOS range 0x00000000..0x0000000F — Read QOS
0x57104 MLB_WRITE_QOS reset 0xC — MLB Write Quality of Service Register
  [3:0] AW_QOS range 0x00000000..0x0000000F — Write QOS
0x58100 UART0_TX_READ_QOS reset 0xC — UART0 TX Read Quality of Service Register
  [3:0] AR_QOS range 0x00000000..0x0000000F — Read QOS
0x58104 UART0_TX_WRITE_QOS reset 0xC — UART0 TX Write Quality of Service Register
  [3:0] AW_QOS range 0x00000000..0x0000000F — Write QOS
0x59100 UART0_RX_READ_QOS reset 0xC — UART0 RX Read Quality of Service Register
  [3:0] AR_QOS range 0x00000000..0x0000000F — Read QOS
0x59104 UART0_RX_WRITE_QOS reset 0xC — UART0 RX Write Quality of Service Register
  [3:0] AW_QOS range 0x00000000..0x0000000F — Write QOS
0x5A100 SP5B_READ_QOS reset 0xC — SP5B Read Quality of Service Register
  [3:0] AR_QOS range 0x00000000..0x0000000F — Read QOS
0x5A104 SP5B_WRITE_QOS reset 0xC — SP5B Write Quality of Service Register
  [3:0] AW_QOS range 0x00000000..0x0000000F — Write QOS
0x5B100 HSMDMA_CH1_IB_READ_QOS reset 0x1 — HSMDMA Channel 1 Read Quality of Service Register
  [3:0] AR_QOS range 0x00000000..0x0000000F — Read QOS
0x5B104 HSMDMA_CH1_IB_WRITE_QOS reset 0x1 — HSMDMA Channel 1 Write Quality of Service Register
  [3:0] AW_QOS range 0x00000000..0x0000000F — Write QOS
0x5C100 UART2_TX_READ_QOS reset 0xC — UART2 TX Read Quality of Service Register
  [3:0] AR_QOS range 0x00000000..0x0000000F — Read QOS
0x5C104 UART2_TX_WRITE_QOS reset 0xC — UART2 TX Write Quality of Service Register
  [3:0] AW_QOS range 0x00000000..0x0000000F — Write QOS
{0x5D100+0x2000*i} SPI{i}TX_READ_QOS reset 0xC (i=0..2) — SPI{i} TX Read Quality of Service Register
  [3:0] AR_QOS range 0x00000000..0x0000000F — Read QOS
{0x5D104+0x2000*i} SPI{i}TX_WRITE_QOS reset 0xC (i=0..2) — SPI{i} TX Write Quality of Service Register
  [3:0] AW_QOS range 0x00000000..0x0000000F — Write QOS
{0x5E100+0x2000*i} SPI{i}RX_READ_QOS reset 0xC (i=0..2) — SPI{i} RX Read Quality of Service Register
  [3:0] AR_QOS range 0x00000000..0x0000000F — Read QOS
{0x5E104+0x2000*i} SPI{i}RX_WRITE_QOS reset 0xC (i=0..2) — SPI{i} RX Write Quality of Service Register
  [3:0] AW_QOS range 0x00000000..0x0000000F — Write QOS
0x63100 SP6A_READ_QOS reset 0xC — SP6A Read Quality of Service Register
  [3:0] AR_QOS range 0x00000000..0x0000000F — Read QOS
0x63104 SP6A_WRITE_QOS reset 0xC — SP6A Write Quality of Service Register
  [3:0] AW_QOS range 0x00000000..0x0000000F — Write QOS
0x64100 SP6B_READ_QOS reset 0xC — SP6B Read Quality of Service Register
  [3:0] AR_QOS range 0x00000000..0x0000000F — Read QOS
0x64104 SP6B_WRITE_QOS reset 0xC — SP6B Write Quality of Service Register
  [3:0] AW_QOS range 0x00000000..0x0000000F — Write QOS
0x65100 LP0_READ_QOS reset 0x7 — LP0 Read Quality of Service Register
  [3:0] AR_QOS range 0x00000000..0x0000000F — Read QOS
0x65104 LP0_WRITE_QOS reset 0x7 — LP0 Write Quality of Service Register
  [3:0] AW_QOS range 0x00000000..0x0000000F — Write QOS
0x66100 SP7A_READ_QOS reset 0xC — SP7A Read Quality of Service Register
  [3:0] AR_QOS range 0x00000000..0x0000000F — Read QOS
0x66104 SP7A_WRITE_QOS reset 0xC — SP7A Write Quality of Service Register
  [3:0] AW_QOS range 0x00000000..0x0000000F — Write QOS
0x67100 SP7B_READ_QOS reset 0xC — SP7B Read Quality of Service Register
  [3:0] AR_QOS range 0x00000000..0x0000000F — Read QOS
0x67104 SP7B_WRITE_QOS reset 0xC — SP7B Write Quality of Service Register
  [3:0] AW_QOS range 0x00000000..0x0000000F — Write QOS
0x68100 SH0_MMR_IB_READ_QOS reset 0x7 — SH0 MMR Read Quality of Service Register
  [3:0] AR_QOS range 0x00000000..0x0000000F — Read QOS
0x68104 SH0_MMR_IB_WRITE_QOS reset 0x7 — SH0 MMR Write Quality of Service Register
  [3:0] AW_QOS range 0x00000000..0x0000000F — Write QOS
0x69100 IDMA_READ_QOS reset 0x7 — iDMA Read Quality of Service Register
  [3:0] AR_QOS range 0x00000000..0x0000000F — Read QOS
0x69104 IDMA_WRITE_QOS reset 0x7 — iDMA Write Quality of Service Register
  [3:0] AW_QOS range 0x00000000..0x0000000F — Write QOS
0x6A100 UART1_TX_READ_QOS reset 0xC — UART1 TX Read Quality of Service Register
  [3:0] AR_QOS range 0x00000000..0x0000000F — Read QOS
0x6A104 UART1_TX_WRITE_QOS reset 0xC — UART1 TX Write Quality of Service Register
  [3:0] AW_QOS range 0x00000000..0x0000000F — Write QOS
0x6B100 UART1_RX_READ_QOS reset 0xC — UART1 RX Read Quality of Service Register
  [3:0] AR_QOS range 0x00000000..0x0000000F — Read QOS
0x6B104 UART1_RX_WRITE_QOS reset 0xC — UART1 RX Write Quality of Service Register
  [3:0] AW_QOS range 0x00000000..0x0000000F — Write QOS
0x6C100 SH0_DPORT_L2_READ_QOS reset 0x7 — SH0 DPORT Read Quality of Service Register
  [3:0] AR_QOS range 0x00000000..0x0000000F — Read QOS
0x6C104 SH0_DPORT_L2_WRITE_QOS reset 0x7 — SH0 DPORT Write Quality of Service Register
  [3:0] AW_QOS range 0x00000000..0x0000000F — Write QOS
0x6D100 LP1_READ_QOS reset 0x7 — LP1 Read Quality of Service Register
  [3:0] AR_QOS range 0x00000000..0x0000000F — Read QOS
0x6D104 LP1_WRITE_QOS reset 0x7 — LP1 Write Quality of Service Register
  [3:0] AW_QOS range 0x00000000..0x0000000F — Write QOS
0x6E100 CRC2_CH1_IB_READ_QOS reset 0x1 — CRC2 Channel 1 Read Quality of Service Register
  [3:0] AR_QOS range 0x00000000..0x0000000F — Read QOS
0x6E104 CRC2_CH1_IB_WRITE_QOS reset 0x1 — CRC2 Channel 1 Write Quality of Service Register
  [3:0] AW_QOS range 0x00000000..0x0000000F — Write QOS
0x6F100 CRC2_CH0_IB_READ_QOS reset 0x1 — CRC2 Channel 0 Read Quality of Service Register
  [3:0] AR_QOS range 0x00000000..0x0000000F — Read QOS
0x6F104 CRC2_CH0_IB_WRITE_QOS reset 0x1 — CRC0 Channel 0 Write Quality of Service Register
  [3:0] AW_QOS range 0x00000000..0x0000000F — Write QOS
0x70100 CRC3_CH1_IB_READ_QOS reset 0x1 — CRC3 Channel 0 Read Quality of Service Register
  [3:0] AR_QOS range 0x00000000..0x0000000F — Read QOS
0x70104 CRC3_CH1_IB_WRITE_QOS reset 0x1 — CRC3 Channel 0 Read Quality of Service Register
  [3:0] AW_QOS range 0x00000000..0x0000000F — Write QOS
0x71100 CRYPTO_IB_READ_QOS reset 0x1 — CRYPTO Read Quality of Service Register
  [3:0] AR_QOS range 0x00000000..0x0000000F — Read QOS
0x71104 CRYPTO_IB_WRITE_QOS reset 0x1 — CRYPTO Write Quality of Service Register
  [3:0] AW_QOS range 0x00000000..0x0000000F — Write QOS
0x72100 CRC3_CH0_IB_READ_QOS reset 0x1 — CRC3 Channel 0 Read Quality of Service Register
  [3:0] AR_QOS range 0x00000000..0x0000000F — Read QOS
0x72104 CRC3_CH0_IB_WRITE_QOS reset 0x1 — CRC3 Channel 0 Write Quality of Service Register
  [3:0] AW_QOS range 0x00000000..0x0000000F — Write QOS
0x73100 MSMDMA1_CH1_IB_READ_QOS reset 0x1 — MSMDMA Channel 1 Read Quality of Service Register
  [3:0] AR_QOS range 0x00000000..0x0000000F — Read QOS
0x73104 MSMDMA1_CH1_IB_WRITE_QOS reset 0x1 — MSMDMA Channel 1 Write Quality of Service Register
  [3:0] AW_QOS range 0x00000000..0x0000000F — Write QOS
0x74100 SH0_FIR_CH0_READ_QOS reset 0x7 — SH0 FIR Channel 0 Read Quality of Service Register
  [3:0] AR_QOS range 0x00000000..0x0000000F — Read QOS
0x74104 SH0_FIR_CH0_WRITE_QOS reset 0x7 — SH0 FIR Channel 0 Write Quality of Service Register
  [3:0] AW_QOS range 0x00000000..0x0000000F — Write QOS
0x75100 SH0_FIR_CH1_READ_QOS reset 0x7 — SH0 FIR Channel 1 Read Quality of Service Register
  [3:0] AR_QOS range 0x00000000..0x0000000F — Read QOS
0x75104 SH0_FIR_CH1_WRITE_QOS reset 0x7 — SH0 FIR Channel 1 Write Quality of Service Register
  [3:0] AW_QOS range 0x00000000..0x0000000F — Write QOS
0x76100 MSMDMA1_CH0_IB_READ_QOS reset 0x1 — MSMDMA Channel 0 Read Quality of Service Register
  [3:0] AR_QOS range 0x00000000..0x0000000F — Read QOS
0x76104 MSMDMA1_CH0_IB_WRITE_QOS reset 0x1 — MSMDMA Channel 0 Write Quality of Service Register
  [3:0] AW_QOS range 0x00000000..0x0000000F — Write QOS
0x77100 HSMDMA1_CH1_IB_READ_QOS reset 0x1 — HSMDMA1 Channel 1 Read Quality of Service Register
  [3:0] AR_QOS range 0x00000000..0x0000000F — Read QOS
0x77104 HSMDMA1_CH1_IB_WRITE_QOS reset 0x1 — HSMDMA1 Channel 1 Write Quality of Service Register
  [3:0] AW_QOS range 0x00000000..0x0000000F — Write QOS
0x78100 DLDMA0_CH0_IB_READ_QOS reset 0x1 — DLDMA0 Channel 0 Read Quality of Service Register
  [3:0] AR_QOS range 0x00000000..0x0000000F — Read QOS
0x78104 DLDMA0_CH0_IB_WRITE_QOS reset 0x1 — DLDMA0 Channel 0 Write Quality of Service Register
  [3:0] AW_QOS range 0x00000000..0x0000000F — Write QOS
0x79100 DLDMA0_CH1_IB_READ_QOS reset 0x1 — DLDMA0 Channel 1 Read Quality of Service Register
  [3:0] AR_QOS range 0x00000000..0x0000000F — Read QOS
0x79104 DLDMA0_CH1_IB_WRITE_QOS reset 0x1 — DLDMA0 Channel 1 Write Quality of Service Register
  [3:0] AW_QOS range 0x00000000..0x0000000F — Write QOS
0x7A100 DLDMA1_CH0_IB_READ_QOS reset 0x1 — DLDMA1 Channel 0 Read Quality of Service Register
  [3:0] AR_QOS range 0x00000000..0x0000000F — Read QOS
0x7A104 DLDMA1_CH0_IB_WRITE_QOS reset 0x1 — DLDMA1 Channel 0 Write Quality of Service Register
  [3:0] AW_QOS range 0x00000000..0x0000000F — Write QOS
0x7B100 DLDMA1_CH1_IB_READ_QOS reset 0x1 — DLDMA1 Channel 1 Read Quality of Service Register
  [3:0] AR_QOS range 0x00000000..0x0000000F — Read QOS
0x7B104 DLDMA1_CH1_IB_WRITE_QOS reset 0x1 — DLDMA1 Channel 1 Write Quality of Service Register
  [3:0] AW_QOS range 0x00000000..0x0000000F — Write QOS
0x7C100 MSMDMA_CH0_IB_READ_QOS reset 0x1 — MSMDMA Channel 0 Read Quality of Service Register
  [3:0] AR_QOS range 0x00000000..0x0000000F — Read QOS
0x7C104 MSMDMA_CH0_IB_WRITE_QOS reset 0x1 — MSMDMA Channel 0 Write Quality of Service Register
  [3:0] AW_QOS range 0x00000000..0x0000000F — Write QOS
0x7D100 MSMDMA_CH1_IB_READ_QOS reset 0x1 — MSMDMA Channel 1 Read Quality of Service Register
  [3:0] AR_QOS range 0x00000000..0x0000000F — Read QOS
0x7D104 MSMDMA_CH1_IB_WRITE_QOS reset 0x1 — MSMDMA Channel 1 Write Quality of Service Register
  [3:0] AW_QOS range 0x00000000..0x0000000F — Write QOS
0x7E100 HSMDMA1_CH0_IB_READ_QOS reset 0x1 — HSMDMA1 Channel 0 Read Quality of Service Register
  [3:0] AR_QOS range 0x00000000..0x0000000F — Read QOS
0x7E104 HSMDMA1_CH0_IB_WRITE_QOS reset 0x1 — HSMDMA1 Channel 0 Write Quality of Service Register
  [3:0] AW_QOS range 0x00000000..0x0000000F — Write QOS
0x80020 S_AXI_IB_SYNC_MODE reset 0x4 — Synchronization Mode Register
  [2:0] sync_mode range 0x00000000..0x00000007 — Synchronization Mode
0x80100 S_AXI_IB_READ_QOS reset 0x7 — S_AXI Read Quality of Service Register
  [3:0] AR_QOS range 0x00000000..0x0000000F — Read QOS
0x80104 S_AXI_IB_WRITE_QOS reset 0x7 — S_AXI Write Quality of Service Register
  [3:0] AW_QOS range 0x00000000..0x0000000F — Write QOS
0x88100 DBG_IB_READ_QOS reset 0x1 — DBG Read Quality of Service Register
  [3:0] AR_QOS range 0x00000000..0x0000000F — Read QOS
0x88104 DBG_IB_WRITE_QOS reset 0x1 — DBG Write Quality of Service Register
  [3:0] AW_QOS range 0x00000000..0x0000000F — Write QOS
0x89100 ETR_IB_READ_QOS reset 0x1 — ETR Read Quality of Service Register
  [3:0] AR_QOS range 0x00000000..0x0000000F — Read QOS
0x89104 ETR_IB_WRITE_QOS reset 0x1 — ETR Write Quality of Service Register
  [3:0] AW_QOS range 0x00000000..0x0000000F — Write QOS
0x8D100 SH0_IIR_CH0_READ_QOS reset 0x7 — SH0 IIR Channel 0 Read Quality of Service Register
  [3:0] AR_QOS range 0x00000000..0x0000000F — Read QOS
0x8D104 SH0_IIR_CH0_WRITE_QOS reset 0x7 — SH0 IIR Channel 0 Write Quality of Service Register
  [3:0] AW_QOS range 0x00000000..0x0000000F — Write QOS
0x8E100 SH0_IIR_CH1_READ_QOS reset 0x7 — SH0 IIR Channel 1 Read Quality of Service Register
  [3:0] AR_QOS range 0x00000000..0x0000000F — Read QOS
0x8E104 SH0_IIR_CH1_WRITE_QOS reset 0x7 — SH0 IIR Channel 1 Write Quality of Service Register
  [3:0] AW_QOS range 0x00000000..0x0000000F — Write QOS
0xC2020 SCB6_IB_SYNC_MODE reset 0x4 — Synchronization Mode Register
  [2:0] sync_mode range 0x00000000..0x00000007 — Synchronization Mode
