# ADSP-SC83xW_HPC register map
Vendor: Analog Devices; Series: ADSP-SC83xW_HPC; File version: 3.0.3.517
CCES peripheral viewer data file for support of ADSP parts
CPU: 
Registers are 32-bit, read-write, reset 0x0 unless marked. A register's access mark holds for its fields unless they carry their own. Offsets are from the block's base; lines under a group give offsets from that group; [hi:lo] are bit positions; {n}, {i} and the like mark numbered series; 'fields as' and 'values as' point back to an identical list; <NAME> marks a mode.

## Memory map
0x00000000 SCB4 size 0x80000
0x00000000 SCB0 size 0x100000 — System Interconnect Fabric
0x00000000 SCB3 size 0x80000
0x30200000 SCB1 size 0x80
0x30400000 SCB5 size 0x80000
0x30FFE000 LP0 size 0x100 — Link Port
0x30FFE100 LP1 size 0x100
0x30FFF000 DMA30 size 0x200
0x30FFF080 DMA36 size 0x200
0x31001000 TWI3 size 0x100
0x31001100 TWI4 size 0x100
0x31001200 TWI5 size 0x100
0x31001400 TWI0 size 0x100 — Two-Wire Interface
0x31001500 TWI1 size 0x100
0x31001600 TWI2 size 0x100
0x31002000 SPORT0 size 0x100 — Serial Port
0x31002100 SPORT1 size 0x100
0x31002200 SPORT2 size 0x100
0x31002300 SPORT3 size 0x100
0x31002400 SPORT4 size 0x100
0x31002500 SPORT5 size 0x100
0x31002600 SPORT6 size 0x100
0x31002700 SPORT7 size 0x100
0x31003000 UART0 size 0x40 — UART
0x31003400 UART1 size 0x40
0x31003800 UART2 size 0x40
0x31004000 PORTA size 0x80 — The General-Purpose Input/Output Port
0x31004080 PORTB size 0x80
0x31004100 PORTC size 0x80
0x31004180 PORTD size 0x80
0x31004200 PORTE size 0x80
0x31004280 PORTF size 0x80 — The General-Purpose Input/Output Port
0x31004600 PADS0 size 0x200 — Pads Controller
0x31005000 PINT0 size 0x40 — The Pin Interrupt module
0x31005100 PINT1 size 0x40
0x31005200 PINT2 size 0x40
0x31005300 PINT3 size 0x40
0x31005400 PINT4 size 0x40
0x31008000 WDOG0 size 0x1000 — Watchdog Timer Unit
0x31008800 WDOG1 size 0x1000
0x31009000 WDOG2 size 0x1000
0x3100B000 CNT0 size 0x100 — General-Purpose Counter
0x31011000 OTPC0 size 0x200 — OTP Memory Controller
0x31012000 SMPU12 size 0x1000
0x31016000 HADC0 size 0x80 — Housekeeping ADC
0x31016800 TMU0 size 0x1000 — Thermal monitoring unit
0x31018000 TIMER0 size 0x400 — General-Purpose Timer Block
0x3101C000 XSPI size 0x4000 — Expanded Serial Peripheral Interface
0x31022000 DMA0 size 0x200 — The Direct Memory Access module
0x31022080 DMA1 size 0x200
0x31022100 DMA2 size 0x200
0x31022180 DMA3 size 0x200
0x31022200 DMA4 size 0x200
0x31022280 DMA5 size 0x200
0x31022300 DMA6 size 0x200
0x31022380 DMA7 size 0x200
{0x31022B00+0x80*n} DMA{n} size 0x200 (n=10..17)
0x31026000 DMA21 size 0x200
0x31026080 DMA20 size 0x200
0x31026100 DMA35 size 0x200
0x31026180 DMA34 size 0x200
0x31026200 DMA38 size 0x200
0x31026280 DMA37 size 0x200
0x3102D000 DMA22 size 0x200
0x3102D080 DMA23 size 0x200
0x3102D100 DMA24 size 0x200
0x3102D180 DMA25 size 0x200
0x3102D200 DMA26 size 0x200
0x3102D280 DMA27 size 0x200
0x3102E000 SPI0 size 0x80 — Serial Peripheral Interface
0x3102F000 SPI1 size 0x80 — Serial Peripheral Interface
0x31030000 SPI2 size 0x80
0x31040000 EMAC0 size 0x2000 — RGMII, RMII, MII Ethernet Controller
0x31046000 CANFD0 size 0x1000 — Controller Access Network with Flexible Data Rate (CANFD)
0x31047000 CANFD1 size 0x1000
0x31070000 DMC0 size 0x400 — Dynamic Memory Controller
0x31071000 DMC0_PHY size 0x100 — 1600MHz DMCPHY (DDR3/DDR3L)
0x31076000 PFB0 size 0x100 — Prefetch buffer mmr
0x31080000 L2CTL0 size 0x10000 — L2 Memory Controller
0x31083000 SMPU2 size 0x1000 — The System Memory Protection Unit
0x31084000 SMPU3 size 0x1000 — The System Memory Protection Unit
0x31085000 SMPU4 size 0x1000
0x31086000 SMPU5 size 0x1000
0x31087000 SMPU6 size 0x1000
0x31089000 SEC0 size 0x1000 — System Event Controller
0x3108A000 TRU0 size 0x800 — Trigger Routing Unit
0x3108B000 SPU0 size 0x2000 — System Protection Unit
0x3108C000 RCU0 size 0x1000 — Reset Control Unit
0x3108D000 CGU0 size 0x80 — Clock Generation Unit
0x3108E000 CGU1 size 0x80 — Clock Generation Unit
0x3108F000 CDU0 size 0x100 — Clock Distribution Unit
0x31090000 DPM0 size 0x100 — Dynamic Power Management
0x31093000 SWU1 size 0x100 — System Watchpoint Unit
0x31094000 SWU2 size 0x100
0x31095000 SWU3 size 0x100
0x31096000 SWU4 size 0x100
0x31097000 SWU11 size 0x100
0x31098000 SWU5 size 0x100
0x3109A000 DMA39 size 0x200 — The Direct Memory Access module
0x3109A080 DMA40 size 0x200 — The Direct Memory Access module
0x3109B000 DMA43 size 0x200 — The Direct Memory Access module
0x3109B080 DMA44 size 0x200 — The Direct Memory Access module
0x3109C000 DMA51 size 0x200
0x3109C080 DMA52 size 0x200
0x3109D000 MLB0 size 0x400 — MediaLB Device Interface Macro 2
0x3109E000 SWU13 size 0x100
0x310A0000 SMPU9 size 0x1000 — The System Memory Protection Unit
0x310A1000 SMPU11 size 0x1000 — The System Memory Protection Unit
0x310A3000 MEC1 size 0x1000 — Memory Error Controller
0x310A4000 MEC2 size 0x1000
0x310A5000 CRC0 size 0x100 — Cyclic Redundancy Check Unit
0x310A6000 CRC1 size 0x100
0x310A7000 DMA8 size 0x200
0x310A7080 DMA9 size 0x200
0x310A7100 DMA18 size 0x200
0x310A7180 DMA19 size 0x200
0x310A7200 DMA45 size 0x200
0x310A7280 DMA46 size 0x200
0x310A7300 DMA47 size 0x200
0x310A7380 DMA48 size 0x200
0x310A8000 SWU12 size 0x100
0x310A9000 MISCREG size 0x200 — Misc registers for module are for integration purpose
0x310AA000 CRC2 size 0x100
0x310AB000 CRC3 size 0x100
0x310AC000 DMA49 size 0x200
0x310AC080 DMA50 size 0x200
0x310AE000 TSGENWR0 size 0x2000
0x310AF000 TSGENRD0 size 0x2000
0x310BF000 FIR1 size 0x1000
0x310C0000 IIR1 size 0x200
0x310C1000 IIR2 size 0x100 — The IIR filter accelerator
0x310C2000 IIR3 size 0x100
0x310C3000 FIR0 size 0x1000 — The FIR accelerator
0x310C4000 IIR0 size 0x200 — The IIR filter accelerator
0x310C9000 SPDIF0 size 0x400 — The S/PDIF module
0x310C9000 DAI0 size 0x400 — The Digital Audio Interface (DAIn) registers are used to configure DAI destinations for the DAI sources shown in the Group A - F Routing tables.
0x310C9000 ASRC0 size 0x400 — Sample Rate Converter Module
0x310C9000 PCG0 size 0x4000 — Precision Clock Generator
0x310C9000 PDM0 size 0x400 — Pulse Density Modulation interface block
0x310CA000 ASRC1 size 0x400
0x310CA000 PDM1 size 0x400
0x310CA000 SPDIF1 size 0x400 — The S/PDIF module
0x310CA000 DAI1 size 0x400 — The Digital Audio Interface (DAIn) registers are used to configure DAI destinations for the DAI sources shown in the Group A - F Routing tables.
0x310CD000 PKTE0 size 0x1000 — Security Packet Engine
0x310D0000 TRNG0 size 0x100 — True Random Number Generator
0x310D4000 PKA0 size 0x4000 — Public Key Accelerator
0x310D8000 PKIC0 size 0x8000 — Public Key Processor Interrupt Controller
0x310E0000 EMDMA1 size 0x100 — Extended Memory DMA
0x310E0000 EMDMA0 size 0x100 — Extended Memory DMA
0x31100000 DAPROM0 size 0x2000
0x31104000 STM0 size 0x2000 — CoreSight STM
0x31108000 CSTF0 size 0x2000
0x31109000 CSETF0 size 0x2000
0x3110A000 CSETR1 size 0x2000
0x3110B000 TRACE0 size 0x2000
0x3110C000 SOC600CTI_TRACE4 size 0x2000
0x3110D000 SOC600CTI_SYS3 size 0x2000
0x3110E000 CSTSGENWR0 size 0x2000
0x31113000 CTI1 size 0x1000 — CSCTI_Register_Definitions
0x31114000 Performance_Monitor_Registers size 0x2000
0x31114000 Miscellaneous_Registers size 0x4000
0x31114000 Trax_Registers size 0x80
0x31114000 OCD_Registers size 0x4000
0x31118000 CSAHBAP size 0x2000
0x31130000 TAPC size 0x2000
0x31140000 SWU7 size 0x100
0x31141000 SWU8 size 0x100
0x31144000 FRACNPLL size 0x1000 — The Fractional Phase-locked loop
0x31145000 PFB1 size 0x100
0x31146000 PWM0 size 0x400 — Pulse-Width Modulator
0x31149000 PFB2 size 0x100
0x3114A000 SMPU13 size 0x1000 — The System Memory Protection Unit

## Interrupts
0 SEC0_ERR (SEC0) — Error
1 CGU0_EVT (CGU0) — Event
2 CGU1_EVT (CGU1) — Event
3 WDOG0_EXP (WDOG0) — Expiration
4 WDOG1_EXP (WDOG1) — Expiration
5 EMAC0_DMA2_RX (EMAC0) — DMAn Rx Channel Interrupt
6 OTPC0_ERR (OTPC0) — Dual-bit Error
7 TMU0_FAULT (TMU0) — Fault
8 TMU0_ALERT (TMU0) — Fault
9 TAPC_KEYFAIL (TAPC) — Test/User Key Fail Interrupt
10 L2CTL0_ECC_ERR (L2CTL0) — ECC Error
12 L2CTL0_EVT (L2CTL0) — Scrub/Initialization Done
13 MEC1_EEIRQ0 (MEC1) — ECC Error Interrupt Request
14 MEC1_EWIRQ0 (MEC1) — ECC Warning to Interrupt Request
16 MEC1_MEIRQ1 (MEC1) — Parity Error Interrupt Request
17 MEC1_PEIRQ2 (MEC1) — Parity Error Interrupt/Trigger Request Bus
18 MEC1_PEIRQ3 (MEC1) — Parity Error Interrupt Request
19 EMAC0_DMA3_TX (EMAC0) — DMAn Tx Channel Interrupt
20 EMAC0_DMA4_TX (EMAC0) — DMAn Tx Channel Interrupt
21 EMAC0_DMA5_TX (EMAC0) — DMAn Tx Channel Interrupt
22 EMAC0_DMA6_TX (EMAC0) — DMAn Tx Channel Interrupt
23 EMAC0_DMA7_TX (EMAC0) — DMAn Tx Channel Interrupt
24 EMAC0_DMA0_RX (EMAC0) — DMAn Rx Channel Interrupt
25 MEC2_EEIRQ0 (MEC2) — ECC Error Interrupt/Trigger Request Bus
26 MEC2_EWIRQ0 (MEC2) — ECC Warning Interrupt/Trigger Request Bus
27 MEC2_MWIRQ1 (MEC2) — Core Memory ECC Warning Interrupt/Trigger Request Bus
28 MEC2_MEIRQ1 (MEC2) — Core Memory Error Interrupt/Trigger Request Bus
29 MEC2_PEIRQ2 (MEC2) — Parity Error Interrupt/Trigger Request Bus
30 MEC2_PEIRQ3 (MEC2) — Parity Error Interrupt/Trigger Request Bus
31 EMAC0_DMA1_RX (EMAC0) — DMAn Rx Channel Interrupt
32 PWM0_TRIP (PWM0) — Trip
33 EMAC0_DMA3_RX (EMAC0) — DMAn Rx Channel Interrupt
42 MEC1_MWIRQ1 (MEC1) — MEC1 Core 1 Mem Warning to Core 1
44 DAI0_IRQH (DAI0) — High Priority Interrupt
45 DAI1_IRQH (DAI1) — High Priority Interrupt
46 DAI0_IRQL (DAI0) — Low Priority Interrupt
47 DAI1_IRQL (DAI1) — Low Priority Interrupt
{n+48} TIMER0_TMR{n:02} (TIMER0) (n=0..15) — Timer {n}
64 TIMER0_STAT (TIMER0) — Status
65 PINT0_BLOCK (PINT0) — Pin Interrupt Block 0
66 PINT1_BLOCK (PINT1) — Pin Interrupt Block 1
67 PINT2_BLOCK (PINT2) — Pin Interrupt Block 2
68 PINT3_BLOCK (PINT3) — Pin Interrupt Block
69 PINT4_BLOCK (PINT4) — Pin Interrupt Block
{4n+81} SPORT{n}_A_DMA (SPORT{n}) (n=0..7) — Channel A DMA
{4n+82} SPORT{n}_A_STAT (SPORT{n}) (n=0..7) — Channel A Status
{4n+83} SPORT{n}_B_DMA (SPORT{n}) (n=0..7) — Channel B DMA
{4n+84} SPORT{n}_B_STAT (SPORT{n}) (n=0..7) — Channel B Status
113 DAI0_GBL_SPORT_INT0 (DAI0) — Global SPORT Interrupt 0
114 DAI0_GBL_SPORT_INT1 (DAI0) — Global SPORT Interrupt 1
115 DAI1_GBL_SPORT_INT0 (DAI1) — Global SPORT Interrupt 0
116 DAI1_GBL_SPORT_INT1 (DAI1) — Global SPORT Interrupt 1
117 LP0_DMA (LP0) — DMA Channel
118 LP0_STAT (LP0) — Status
119 LP1_DMA (LP1) — DMA Channel
120 LP1_STAT (LP1) — Status
121 SPI0_TXDMA (SPI0) — TX DMA Channel
122 SPI0_RXDMA (SPI0) — RX DMA Channel
123 SPI0_STAT (SPI0) — Status
124 SPI0_ERR (SPI0) — Error
125 SPI1_TXDMA (SPI1) — TX DMA Channel
126 SPI1_RXDMA (SPI1) — RX DMA Channel
127 SPI1_STAT (SPI1) — Status
128 SPI1_ERR (SPI1) — Error
129 SPI2_TXDMA (SPI2) — TX DMA Channel
130 SPI2_RXDMA (SPI2) — RX DMA Channel
131 SPI2_STAT (SPI2) — Status
132 SPI2_ERR (SPI2) — Error
137 XSPI_IRQ (XSPI) — Error
138 UART0_TXDMA (UART0) — Transmit DMA
139 UART0_RXDMA (UART0) — Receive DMA
140 UART0_STAT (UART0) — Status
141 UART1_TXDMA (UART1) — Transmit DMA
142 UART1_RXDMA (UART1) — Receive DMA
143 UART1_STAT (UART1) — Status
144 UART2_TXDMA (UART2) — Transmit DMA
145 UART2_RXDMA (UART2) — Receive DMA
146 UART2_STAT (UART2) — Status
150 TWI0_DATA (TWI0) — Data Interrupt
151 TWI1_DATA (TWI1) — Data Interrupt
152 TWI2_DATA (TWI2) — Data Interrupt
153 TWI3_DATA (TWI3) — Data Interrupt
154 TWI4_DATA (TWI4) — Data Interrupt
155 TWI5_DATA (TWI5) — Data Interrupt
156 CNT0_STAT (CNT0) — Status
157 PWM0_SYNC (PWM0) — PWMTMR Grouped
158 CTI1_EVT0 (CTI1) — Core 1 CTI Event
160 PKIC0_IRQ (PKIC0) — Interrupt
161 PKTE0_IRQ (PKTE0) — Interrupt
162 EMAC0_DMA4_RX (EMAC0) — DMAn Rx Channel Interrupt
163 EMAC0_DMA5_RX (EMAC0) — DMAn Rx Channel Interrupt
164 EMAC0_DMA6_RX (EMAC0) — DMAn Rx Channel Interrupt
165 EMAC0_DMA7_RX (EMAC0) — DMAn Rx Channel Interrupt
166 FIR0_DMA (FIR0) — Core 1 DMA
167 FIR0_STAT (FIR0) — Core 1 Status
168 IIR0_DMA (IIR0) — Core 1 DMA
169 IIR0_STAT (IIR0) — Core 1 Status
170 IIR1_DMA (IIR1) — Core 1 DMA
171 IIR1_STAT (IIR1) — Core 1 Status
172 IIR2_DMA (IIR2) — Core 1 DMA
173 IIR2_STAT (IIR2) — Core 1 Status
174 IIR3_DMA (IIR3) — Core 1 DMA
175 IIR3_STAT (IIR3) — Core 1 Status
176 FIR1_DMA (FIR1) — Core 2 DMA
177 FIR1_STAT (FIR1) — Core 2 Status
186 HADC0_EVT (HADC0) — Event
187 MLB0_INT0 (MLB0) — Interrupt 0
188 MLB0_INT1 (MLB0) — Interrupt 1
189 MLB0_STAT (MLB0) — Status
190 CRC0_ERR (CRC0) — Error
191 CRC1_ERR (CRC1) — Error
196 CRC0_DCNTEXP (CRC0) — Datacount Expiration
197 CRC1_DCNTEXP (CRC1) — Datacount Expiration
198 CRC2_ERR (CRC2) — Error
199 CRC3_ERR (CRC3) — Error
204 CRC2_DCNTEXP (CRC2) — Datacount Expiration
205 CRC3_DCNTEXP (CRC3) — Datacount Expiration
210 EMDMA0_DONE (EMDMA0) — Transfer Done
211 EMDMA1_DONE (EMDMA1) — Transfer Done
216 SPU0_INT (SPU0) — Interrupt
221 EMAC0_STAT (EMAC0) — Status
222 EMAC0_PWR (EMAC0) — Power Interrupt
223 EMAC0_DMA0_TX (EMAC0) — DMAn Tx Channel Interrupt
224 EMAC0_DMA1_TX (EMAC0) — DMAn Tx Channel Interrupt
225 EMAC0_DMA2_TX (EMAC0) — DMAn Tx Channel Interrupt
226 EMAC0_MAC (EMAC0) — MAC Interrupt
227 WDOG2_EXP (WDOG2) — Expiration
231 CANFD0_WU (CANFD0) — Wakeup Interrupt
233 CANFD0_IRQ (CANFD0) — CAN Interrupt
235 CANFD0_MSG (CANFD0) — Message Receive/Transmit Interrupt
236 CANFD1_WU (CANFD1) — Wakeup Interrupt
237 FRACNPLL_FRAC_LOCK (FRACNPLL) — Frac Pll Lock Interrupt
238 CANFD1_IRQ (CANFD1) — CAN Interrupt
239 FRACNPLL_FRAC_UNLOCK (FRACNPLL) — Frac Pll Unlock Interrupt
240 CANFD1_MSG (CANFD1) — Message Receive/Transmit Interrupt
{n+238} TRU0_SLV{n} (TRU0) (n=4..11) — Interrupt {n}
251 FIR0_BUS_ERR (FIR0) — Core 1 FIR Bus Error
252 IIR0_BUS_ERR (IIR0) — Core 1 IIR Bus Error
253 IIR1_BUS_ERR (IIR1) — Core 1 IIR Bus Error
254 IIR2_BUS_ERR (IIR2) — Core 1 IIR Bus Error
255 IIR3_BUS_ERR (IIR3) — Core 1 IIR Bus Error
256 FIR1_BUS_ERR (FIR1) — Core 2 FIR Bus Error
261 SPI0_TXDMA_ERR (SPI0) — TX DMA Channel Error
262 SPI0_RXDMA_ERR (SPI0) — RX DMA Channel Error
263 SPI1_TXDMA_ERR (SPI1) — TX DMA Channel Error
264 SPI1_RXDMA_ERR (SPI1) — RX DMA Channel Error
265 SPI2_TXDMA_ERR (SPI2) — TX DMA Channel Error
266 SPI2_RXDMA_ERR (SPI2) — RX DMA Channel Error
269 UART0_TXDMA_ERR (UART0) — Transmit DMA Error
270 UART0_RXDMA_ERR (UART0) — Receive DMA Error
271 UART1_TXDMA_ERR (UART1) — Transmit DMA Error
272 UART1_RXDMA_ERR (UART1) — Receive DMA Error
273 UART2_TXDMA_ERR (UART2) — Transmit DMA Error
274 UART2_RXDMA_ERR (UART2) — Receive DMA Error
277 LP0_DMA_ERR (LP0) — DMA Data Error
278 LP1_DMA_ERR (LP1) — DMA Data Error
{2n+297} SPORT{n}_A_DMA_ERR (SPORT{n}) (n=0..7) — Channel A DMA Error
{2n+298} SPORT{n}_B_DMA_ERR (SPORT{n}) (n=0..7) — Channel B DMA Error
314 SWU1_EVT (SWU1) — Event L2 Memory DMA Port 0
315 SWU2_EVT (SWU2) — Event L2 Memory Core Port 0
316 SWU7_EVT (SWU7) — Event SHARC0 Target Port 1
317 SWU8_EVT (SWU8) — Event SHARC0 Target Port 2
320 SWU11_EVT (SWU11) — Event SMMR
321 SWU12_EVT (SWU12) — Event SPI2/XSPI
322 SWU13_EVT (SWU13) — Event DMC0
323 SWU3_EVT (SWU3) — Event CL2_1
324 SWU4_EVT (SWU4) — Event DL2_1
325 SWU5_EVT (SWU5) — Event CL2_2

## Notices in the file
Copyright (c) 2018-2025 Analog Devices, Inc. All Rights Reserved.
This software is proprietary to Analog Devices, Inc. and its licensors.
