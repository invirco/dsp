// model_tdm_tx.v — behavioural model of a DSP-side TDM transmitter.
//
// The mirror of model_tdm_rx: a SPORT configured MFD=1 launching on the
// BCK FALLING edge so a receiver sampling on the rising edge reads it in
// the following period. FS is generated by LOGIC, so this model FOLLOWS
// it: the falling edge at which FS reads high is the one that launches
// slot 0 bit 31, because that bit is sampled at the next rising edge.
//
// `slots` is a flat SLOTS*32 bus, slot s in bits [s*32 +: 32], MSB first
// on the wire. It is latched at the start of each frame so a change mid
// frame cannot tear the model itself — the whole point of this model is
// to be the arbiter of whether the DUT tears.
//
// Simulation only — never in the Quartus project.

`default_nettype none

module model_tdm_tx #(
    parameter integer SLOTS = 8
) (
    input  wire                bck,
    input  wire                fs,
    input  wire [SLOTS*32-1:0] slots,
    output reg                 d
);
    localparam integer BITS = SLOTS * 32;

    reg [SLOTS*32-1:0] held;
    reg                pending;
    integer            bitpos;      // -1 = idle, else 0..BITS-1
    integer            frames;

    initial begin
        bitpos  = -1;
        frames  = 0;
        pending = 1'b0;
        held   = {SLOTS*32{1'b0}};
        d      = 1'b0;
    end

    // FS is SAMPLED on the rising edge (as the receiver samples it) and
    // data is LAUNCHED on the falling edge. Doing both on the falling edge
    // would race the LOGIC clkgen, which updates bck8 and fs8 in the same
    // sysclk NBA region: the model would then read the post-update fs and
    // start its frame one BCK period early.
    always @(posedge bck) begin
        if (fs === 1'b1) begin
            held    = slots;        // one coherent frame, latched
            pending = 1'b1;
        end
    end

    always @(negedge bck) begin
        if (pending) begin
            bitpos  = 0;
            pending = 1'b0;
            frames  = frames + 1;
        end

        if (bitpos >= 0) begin
            // slot bitpos/32, bit 31 - (bitpos%32), MSB first
            d      = held[(bitpos / 32) * 32 + (31 - (bitpos % 32))];
            bitpos = (bitpos == BITS - 1) ? -1 : bitpos + 1;
        end else begin
            d = 1'b0;
        end
    end
endmodule

`default_nettype wire
