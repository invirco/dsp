# ADSP-2183xW_LPC register map
Vendor: Analog Devices; Series: ADSP-2183xW_LPC; File version: 3.0.3.517
CPU: 
Registers are 32-bit, read-write, reset 0x0 unless marked. A register's access mark holds for its fields unless they carry their own. Offsets are from the block's base; [hi:lo] are bit positions.

## SCB3
Base 0x00000000
0x2020 APB_CLKO8_IB_SYNC_MODE reset 0x4 — CLK08 Synchronization Mode Register
  [2:0] SYNC_MODE range 0x00000000..0x00000007 — Synchronization Mode
0x5020 APB_CLKO3_IB_SYNC_MODE reset 0x4 — CLK03 Synchronization Mode Register
  [2:0] SYNC_MODE range 0x00000000..0x00000007 — Synchronization Mode
0xB020 APB_CLKPWM_IB_SYNC_MODE reset 0x4 — PWM Clock Synchronization Mode Register
  [2:0] SYNC_MODE range 0x00000000..0x00000007 — Synchronization Mode
0x10020 APB_CLKO4_IB_SYNC_MODE reset 0x4 — CLK04 Synchronization Mode Register
  [2:0] SYNC_MODE range 0x00000000..0x00000007 — Synchronization Mode
0x11020 APB_M33_IB_SYNC_MODE reset 0x4 — M33 Synchronization Mode Register
  [2:0] SYNC_MODE range 0x00000000..0x00000007 — Synchronization Mode

## SCB4
Base 0x00000000
0x00 REMAP
  [0] REMAP wo range 0x00000000..0x00000001
0x42100 iir2_ch0_ib_read_qos reset 0xC — IIR2 CH2 IB Read QOS Register
  [3:0] AR_QOS range 0x00000000..0x0000000F
0x42104 iir2_ch0_ib_write_qos reset 0xC
  [3:0] AW_QOS range 0x00000000..0x0000000F
0x43100 SHARC_DPORT_IB_READ_QOS reset 0xC
  [3:0] AR_QOS range 0x00000000..0x0000000F
0x43104 SHARC_DPORT_IB_WRITE_QOS reset 0xC
  [3:0] AW_QOS range 0x00000000..0x0000000F
0x44100 FABRIC_S2PORT_IB_READ_QOS reset 0xC
  [3:0] AR_QOS range 0x00000000..0x0000000F
0x44104 FABRIC_S2PORT_IB_WRITE_QOS reset 0xC
  [3:0] AW_QOS range 0x00000000..0x0000000F
0x45100 fir_ch0_read_qos reset 0xC
  [3:0] AR_QOS range 0x00000000..0x0000000F
0x45104 fir_ch0_write_qos reset 0xC
  [3:0] AW_QOS range 0x00000000..0x0000000F
0x46100 FIR_CH1_READ_QOS reset 0xC
  [3:0] AR_QOS range 0x00000000..0x0000000F
0x46104 FIR_CH1_WRITE_QOS reset 0xC
  [3:0] AW_QOS range 0x00000000..0x0000000F
0x47100 IIR0_CH0_IB_READ_QOS reset 0xC
  [3:0] AR_QOS range 0x00000000..0x0000000F
0x47104 IIR0_CH0_IB_WRITE_QOS reset 0xC
  [3:0] AW_QOS range 0x00000000..0x0000000F
0x48100 IIR0_CH1_IB_READ_QOS reset 0xC
  [3:0] AR_QOS range 0x00000000..0x0000000F
0x48104 IIR0_CH1_IB_WRITE_QOS reset 0xC
  [3:0] AW_QOS range 0x00000000..0x0000000F
0x49100 IIR2_CH1_IB_READ_QOS reset 0xC
  [3:0] AR_QOS range 0x00000000..0x0000000F
0x49104 IIR2_CH1_IB_WRITE_QOS reset 0xC
  [3:0] AW_QOS range 0x00000000..0x0000000F
0x4A100 FABRIC_S1PORT_IB_READ_QOS reset 0xC
  [3:0] AR_QOS range 0x00000000..0x0000000F
0x4A104 FABRIC_S1PORT_IB_WRITE_QOS reset 0xC
  [3:0] AW_QOS range 0x00000000..0x0000000F
0x4B100 iir3_ch0_ib_read_qos reset 0xC
  [3:0] AR_QOS range 0x00000000..0x0000000F
0x4B104 iir3_ch0_ib_write_qos reset 0xC
  [3:0] AW_QOS range 0x00000000..0x0000000F
0x4C100 IIR3_CH1_IB_READ_QOS reset 0xC
  [3:0] AR_QOS range 0x00000000..0x0000000F
0x4C104 IIR3_CH1_IB_WRITE_QOS reset 0xC
  [3:0] AW_QOS range 0x00000000..0x0000000F
0x4E100 IIR1_CH0_IB_READ_QOS reset 0xC
  [3:0] AR_QOS range 0x00000000..0x0000000F
0x4E104 IIR1_CH0_IB_WRITE_QOS reset 0xC
  [3:0] AW_QOS range 0x00000000..0x0000000F
0x4F100 IIR1_CH1_IB_READ_QOS reset 0xC
  [3:0] AR_QOS range 0x00000000..0x0000000F
0x4F104 IIR1_CH1_IB_WRITE_QOS reset 0xC
  [3:0] AW_QOS range 0x00000000..0x0000000F
0x50100 FIR1_CH1_READ_QOS reset 0xC
  [3:0] AR_QOS range 0x00000000..0x0000000F
0x50104 FIR1_CH1_WRITE_QOS reset 0xC
  [3:0] AW_QOS range 0x00000000..0x0000000F
0x51100 fir1_ch0_read_qos reset 0xC
  [3:0] AR_QOS range 0x00000000..0x0000000F
0x51104 fir1_ch0_write_qos reset 0xC
  [3:0] AW_QOS range 0x00000000..0x0000000F

## SCB1
Base 0x30200000
0x20 mst_ib_sync_mode reset 0x4 — Bus Requester Synchronization Mode Register
  [2:0] sync_mode range 0x00000000..0x00000007 — Synchronization Mode

## SCB5
Base 0x30400000
0x00 remap
  [4:0] remap wo range 0x00000000..0x0000001F

## Notices in the file
Copyright (c) 2018-2025 Analog Devices, Inc. All Rights Reserved.
This software is proprietary to Analog Devices, Inc. and its licensors.
